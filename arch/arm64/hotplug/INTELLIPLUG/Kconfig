## arch/arm64/hotplug/INTELLIPLUG/Kconfig
```kconfig
config INTELLI_PLUG
	   bool "Intelli hotplug driver"
	   depends on MSM_RUN_QUEUE_STATS
	   default n
	   help
		 This enables kernel based multi core control.
```
